AUTOSAR XML (schema 4-2-1)
package /ActiveEcuC
  module config vSet: implementation-config-variant=VARIANT-PRE-COMPILE, module-description=vSet_Impl
    vSetCalibration
    vSetGeneral: vSetDummyStatementKind=SelfAssignment
    vSetPlatform:
      vSetSizeOfRAMPointer = Size32Bit
      vSetByteOrder = LITTLE_ENDIAN
      vSetBitOrder = LSB_to_MSB
      vSetSizeOfROMPointer = Size32Bit
      vSetCPUType = CPU32Bit
      vSetSizeOfInt = Size32Bit
      vSetSizeOfEnum = Size32Bit
