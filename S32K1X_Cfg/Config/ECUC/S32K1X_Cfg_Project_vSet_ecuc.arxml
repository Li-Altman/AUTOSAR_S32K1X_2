AUTOSAR XML (schema 00045)
package /ActiveEcuC
  module config vSet: implementation-config-variant=VARIANT-PRE-COMPILE, module-description=vSet_Impl
    vSetCalibration
    vSetGeneral
    vSetPlatform
