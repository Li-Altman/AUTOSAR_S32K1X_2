AUTOSAR XML (schema 4-2-1)
package /ActiveEcuC
  module config Rte: implementation-config-variant=VARIANT-PRE-COMPILE, module-description=Rte_Impl
    RteInitializationBehavior: RteInitializationStrategy=RTE_INITIALIZATION_STRATEGY_AT_DATA_DECLARATION, RteSectionInitializationPolicy=INIT
    RteGeneration:
      RteGenerationMode = COMPATIBILITY_MODE
      RteIocInteractionReturnValue = RTE_IOC
      RteValueRangeCheckEnabled = false
      RteCalibrationSupport = NONE
      RteCodeVendorId = 30
      RteDevErrorDetect = false
      RteDevErrorDetectUninit = false
      RteMeasurementSupport = false
      RteOptimizationMode = MEMORY
      RteVfbTraceEnabled = false
    RteBswGeneral: RteSchMVersionInfoApi=false, RteUseComShadowSignalApi=false
    13 x RteBswModuleInstance:
      Dio: RteBswImplementationRef=Dio_Impl, RteBswModuleConfigurationRef=Dio
        31 x RteBswExclusiveAreaImpl, all with RteExclusiveAreaImplMechanism=ALL_INTERRUPT_BLOCKING:
          DIO_EXCLUSIVE_AREA_{00..30}: RteBswExclusiveAreaRef=DIO_EXCLUSIVE_AREA_{00..30}
      BswM: RteBswImplementationRef=BswM_Impl, RteBswModuleConfigurationRef=BswM
        BSWM_EXCLUSIVE_AREA_0 (RteBswExclusiveAreaImpl): RteExclusiveAreaImplMechanism=ALL_INTERRUPT_BLOCKING, RteBswExclusiveAreaRef=BSWM_EXCLUSIVE_AREA_0
      Can: RteBswImplementationRef=Can_Impl, RteBswModuleConfigurationRef=Can
        7 x RteBswExclusiveAreaImpl, all with RteExclusiveAreaImplMechanism=ALL_INTERRUPT_BLOCKING:
          CAN_EXCLUSIVE_AREA_{0..6}: RteBswExclusiveAreaRef=CAN_EXCLUSIVE_AREA_{0..6}
        3 x RteBswEventToTaskMapping, all with RteBswImmediateRestart=false:
          Can_MainFunction_BusOffTimingEvent0: RteBswEventRef=Can_MainFunction_BusOffTimingEvent0
          Can_MainFunction_WakeupTimingEvent0: RteBswEventRef=Can_MainFunction_WakeupTimingEvent0
          Can_MainFunction_ModeTimingEvent0: RteBswEventRef=Can_MainFunction_ModeTimingEvent0
      CanIf: RteBswImplementationRef=CanIf_Impl, RteBswModuleConfigurationRef=CanIf
        8 x RteBswExclusiveAreaImpl, all with RteExclusiveAreaImplMechanism=ALL_INTERRUPT_BLOCKING:
          CANIF_EXCLUSIVE_AREA_{0..7}: RteBswExclusiveAreaRef=CANIF_EXCLUSIVE_AREA_{0..7}
      CanSM: RteBswImplementationRef=CanSM_Impl, RteBswModuleConfigurationRef=CanSM
        6 x RteBswExclusiveAreaImpl, all with RteExclusiveAreaImplMechanism=ALL_INTERRUPT_BLOCKING:
          CANSM_EXCLUSIVE_AREA_{1..6}: RteBswExclusiveAreaRef=CANSM_EXCLUSIVE_AREA_{1..6}
        CanSM_MainFunctionTimingEvent0 (RteBswEventToTaskMapping): RteBswImmediateRestart=false, RteBswEventRef=CanSM_MainFunctionTimingEvent0
      Com: RteBswImplementationRef=Com_Impl, RteBswModuleConfigurationRef=Com
        3 x RteBswExclusiveAreaImpl, all with RteExclusiveAreaImplMechanism=ALL_INTERRUPT_BLOCKING:
          COM_EXCLUSIVE_AREA_TX: RteBswExclusiveAreaRef=COM_EXCLUSIVE_AREA_TX
          COM_EXCLUSIVE_AREA_RX: RteBswExclusiveAreaRef=COM_EXCLUSIVE_AREA_RX
          COM_EXCLUSIVE_AREA_BOTH: RteBswExclusiveAreaRef=COM_EXCLUSIVE_AREA_BOTH
        Com_MainFunctionTxTimingEvent0 (RteBswEventToTaskMapping): RteBswImmediateRestart=false, RteBswEventRef=Com_MainFunctionTxTimingEvent0
        Com_MainFunctionRxTimingEvent0 (RteBswEventToTaskMapping): RteBswImmediateRestart=false, RteBswEventRef=Com_MainFunctionRxTimingEvent0
      ComM: RteBswImplementationRef=ComM_Impl, RteBswModuleConfigurationRef=ComM
        COMM_EXCLUSIVE_AREA_0 (RteBswExclusiveAreaImpl): RteExclusiveAreaImplMechanism=ALL_INTERRUPT_BLOCKING, RteBswExclusiveAreaRef=COMM_EXCLUSIVE_AREA_0
        COMM_EXCLUSIVE_AREA_1 (RteBswExclusiveAreaImpl): RteExclusiveAreaImplMechanism=ALL_INTERRUPT_BLOCKING, RteBswExclusiveAreaRef=COMM_EXCLUSIVE_AREA_1
        ComM_MainFunction_0TimingEvent0 (RteBswEventToTaskMapping): RteBswImmediateRestart=false, RteBswEventRef=ComM_MainFunction_0TimingEvent0
      Det: RteBswImplementationRef=Det_Impl, RteBswModuleConfigurationRef=Det
        DET_EXCLUSIVE_AREA_0 (RteBswExclusiveAreaImpl): RteExclusiveAreaImplMechanism=ALL_INTERRUPT_BLOCKING, RteBswExclusiveAreaRef=DET_EXCLUSIVE_AREA_0
      EcuM: RteBswImplementationRef=EcuM_Impl, RteBswModuleConfigurationRef=EcuM
        3 x RteBswExclusiveAreaImpl, all with RteExclusiveAreaImplMechanism=ALL_INTERRUPT_BLOCKING:
          ECUM_EXCLUSIVE_AREA_{0..2}: RteBswExclusiveAreaRef=ECUM_EXCLUSIVE_AREA_{0..2}
        EcuM_MainFunctionTimingEvent0 (RteBswEventToTaskMapping): RteBswImmediateRestart=false, RteBswEventRef=EcuM_MainFunctionTimingEvent0
      Mcu: RteBswImplementationRef=Mcu_Impl, RteBswModuleConfigurationRef=Mcu
        31 x RteBswExclusiveAreaImpl, all with RteExclusiveAreaImplMechanism=ALL_INTERRUPT_BLOCKING:
          MCU_EXCLUSIVE_AREA_{00..30}: RteBswExclusiveAreaRef=MCU_EXCLUSIVE_AREA_{00..30}
      PduR: RteBswImplementationRef=PduR_Impl, RteBswModuleConfigurationRef=PduR
        PDUR_EXCLUSIVE_AREA_0 (RteBswExclusiveAreaImpl): RteExclusiveAreaImplMechanism=ALL_INTERRUPT_BLOCKING, RteBswExclusiveAreaRef=PDUR_EXCLUSIVE_AREA_0
      Port: RteBswImplementationRef=Port_Impl, RteBswModuleConfigurationRef=Port
        31 x RteBswExclusiveAreaImpl, all with RteExclusiveAreaImplMechanism=ALL_INTERRUPT_BLOCKING:
          PORT_EXCLUSIVE_AREA_{00..30}: RteBswExclusiveAreaRef=PORT_EXCLUSIVE_AREA_{00..30}
      Rte: RteBswImplementationRef=Rte_Impl, RteBswModuleConfigurationRef=Rte
    4 x RteSwComponentInstance:
      EcuM_EcuSwComposition: RteSoftwareComponentInstanceRef=EcuM
        8 x RteEventToTaskMapping, all with RteImmediateRestart=false:
          Timer_EcuM_MainFunction: RteEventRef=Timer_EcuM_MainFunction
          OpEventSelectShutdownTarget_SelectShutdownTarget_EcuM_ShutdownTarget: RteEventRef=OpEventSelectShutdownTarget_SelectShutdownTarget_EcuM_ShutdownTarget
          OpEventGetShutdownTarget_GetShutdownTarget_EcuM_ShutdownTarget: RteEventRef=OpEventGetShutdownTarget_GetShutdownTarget_EcuM_ShutdownTarget
          OpEventGetLastShutdownTarget_GetLastShutdownTarget_EcuM_ShutdownTarget: RteEventRef=OpEventGetLastShutdownTarget_GetLastShutdownTarget_EcuM_ShutdownTarget
          OpEventSelectShutdownCause_SelectShutdownCause_EcuM_ShutdownTarget: RteEventRef=OpEventSelectShutdownCause_SelectShutdownCause_EcuM_ShutdownTarget
          OpEventGetShutdownCause_GetShutdownCause_EcuM_ShutdownTarget: RteEventRef=OpEventGetShutdownCause_GetShutdownCause_EcuM_ShutdownTarget
          OpEventSelectBootTarget_SelectBootTarget_EcuM_BootTarget: RteEventRef=OpEventSelectBootTarget_SelectBootTarget_EcuM_BootTarget
          OpEventGetBootTarget_GetBootTarget_EcuM_BootTarget: RteEventRef=OpEventGetBootTarget_GetBootTarget_EcuM_BootTarget
      BswM_EcuSwComposition: RteSoftwareComponentInstanceRef=BswM
      ComM_EcuSwComposition: RteSoftwareComponentInstanceRef=ComM
        13 x RteEventToTaskMapping, all with RteImmediateRestart=false:
          Timer_ComM_MainFunction_0: RteEventRef=Timer_ComM_MainFunction_0
          OpEventGetInhibitionStatus_GetInhibitionStatus_CL_CN_CAN1_06c72675: RteEventRef=OpEventGetInhibitionStatus_GetInhibitionStatus_CL_CN_CAN1_06c72675
          OpEventGetInhibitionStatus_GetInhibitionStatus_CW_CN_CAN1_06c72675: RteEventRef=OpEventGetInhibitionStatus_GetInhibitionStatus_CW_CN_CAN1_06c72675
          OpEventLimitECUToNoComMode_LimitECUToNoComMode_modeLimitation: RteEventRef=OpEventLimitECUToNoComMode_LimitECUToNoComMode_modeLimitation
          OpEventReadInhibitCounter_ReadInhibitCounter_modeLimitation: RteEventRef=OpEventReadInhibitCounter_ReadInhibitCounter_modeLimitation
          OpEventResetInhibitCounter_ResetInhibitCounter_modeLimitation: RteEventRef=OpEventResetInhibitCounter_ResetInhibitCounter_modeLimitation
          OpEventSetECUGroupClassification_SetECUGroupClassification_modeLimitation: RteEventRef=OpEventSetECUGroupClassification_SetECUGroupClassification_modeLimitation
          OpEventLimitChannelToNoComMode_LimitChannelToNoComMode_CL_CN_CAN1_06c72675: RteEventRef=OpEventLimitChannelToNoComMode_LimitChannelToNoComMode_CL_CN_CAN1_06c72675
          OpEventPreventWakeUp_PreventWakeUp_CW_CN_CAN1_06c72675: RteEventRef=OpEventPreventWakeUp_PreventWakeUp_CW_CN_CAN1_06c72675
          OpEventRequestComMode_RequestComMode_UR_CN_CAN1_d32cea4f: RteEventRef=OpEventRequestComMode_RequestComMode_UR_CN_CAN1_d32cea4f
          OpEventGetCurrentComMode_GetCurrentComMode_UR_CN_CAN1_d32cea4f: RteEventRef=OpEventGetCurrentComMode_GetCurrentComMode_UR_CN_CAN1_d32cea4f
          OpEventGetMaxComMode_GetMaxComMode_UR_CN_CAN1_d32cea4f: RteEventRef=OpEventGetMaxComMode_GetMaxComMode_UR_CN_CAN1_d32cea4f
          OpEventGetRequestedComMode_GetRequestedComMode_UR_CN_CAN1_d32cea4f: RteEventRef=OpEventGetRequestedComMode_GetRequestedComMode_UR_CN_CAN1_d32cea4f
      Det_EcuSwComposition: RteSoftwareComponentInstanceRef=Det
