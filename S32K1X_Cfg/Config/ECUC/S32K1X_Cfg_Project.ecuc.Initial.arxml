AUTOSAR XML (schema 4-2-1)
package /InitialEcuC
  ecuc value collection InitialEcuC: ecuc-values=[Base, Can, CanIf, CanNm, CanSM, Com, ComM, Dio, EcuC, EcuM, Mcu, Nm, PduR, Port, Resource]
  module config Base
    CommonPublishedInformation:  # Project Standard Configuration
      ArReleaseMajorVersion = 4
      ArReleaseMinorVersion = 2
      ArReleaseRevisionVersion = 2
      ModuleId = 0
      SwMajorVersion = 1
      SwMinorVersion = 0
      SwPatchVersion = 1
      VendorId = 43
  module config Can
    CanConfigSet
      CT_CAN1_a48a0788 (CanController):
        CanControllerActivation = true
        CanControllerDefaultBaudrate = CanControllerBaudrateConfig
        CanControllerSystemRef = CT_CAN1
        CanWakeupSourceRef = EcuMCommonConfiguration/CN_CAN1_06c72675
        CanControllerBaudrateConfig: CanControllerBaudRate=500
      CN_CAN1_06c72675_Tx (CanHardwareObject): CanHandleType=BASIC, CanIdValue=0, CanObjectType=TRANSMIT, CanControllerRef=CanConfigSet/CT_CAN1_a48a0788
      CN_CAN1_a2caa1f8_Rx (CanHardwareObject): CanHandleType=BASIC, CanIdType=STANDARD, CanIdValue=0, CanObjectType=RECEIVE, CanControllerRef=CanConfigSet/CT_CAN1_a48a0788
    CanGeneral: CanIndex=0
  module config CanIf
    CanIfCtrlDrvCfg_7d254554 (CanIfCtrlDrvCfg): CanIfCtrlDrvInitHohConfigRef=CanIfInitHohCfg, CanIfCtrlDrvNameRef=CanGeneral
      CT_CAN1_a48a0788 (CanIfCtrlCfg): CanIfCtrlCanCtrlRef=CanConfigSet/CT_CAN1_a48a0788
    CanIfInitCfg
      CHNL_51ff2425 (CanIfBufferCfg): CanIfBufferSize=0, CanIfBufferHthRef=CanIfInitHohCfg/CN_CAN1_06c72675_Tx
      CanIfInitHohCfg: CanIfInitRefCfgSet=CanConfigSet
        CN_CAN1_a2caa1f8_Rx (CanIfHrhCfg): CanIfHrhCanCtrlIdRef=CanIfCtrlDrvCfg_7d254554/CT_CAN1_a48a0788, CanIfHrhIdSymRef=CanConfigSet/CN_CAN1_a2caa1f8_Rx
        CN_CAN1_06c72675_Tx (CanIfHthCfg): CanIfHthCanCtrlIdRef=CanIfCtrlDrvCfg_7d254554/CT_CAN1_a48a0788, CanIfHthIdSymRef=CanConfigSet/CN_CAN1_06c72675_Tx
      LCU1_1_oCAN1_ccfff82a_Rx (CanIfRxPduCfg):
        CanIfRxPduCanId = 291
        CanIfRxPduCanIdType = STANDARD_CAN
        CanIfRxPduDlc = 8
        CanIfRxPduUserRxIndicationName = PduR_CanIfRxIndication
        CanIfRxPduUserRxIndicationUL = PDUR
        CanIfRxPduHrhIdRef = CanIfInitHohCfg/CN_CAN1_a2caa1f8_Rx
        CanIfRxPduRef = EcucPduCollection/LCU1_1_oCAN1_27262c0c_Rx
      BCM1_1_oCAN1_79afebbe_Tx (CanIfTxPduCfg):
        CanIfTxPduCanId = 1110
        CanIfTxPduCanIdType = STANDARD_CAN
        CanIfTxPduDlc = 8
        CanIfTxPduUserTxConfirmationName = PduR_CanIfTxConfirmation
        CanIfTxPduUserTxConfirmationUL = PDUR
        CanIfTxPduBufferRef = CanIfInitCfg/CHNL_51ff2425
        CanIfTxPduRef = EcucPduCollection/BCM1_1_oCAN1_e0b79f82_Tx
    CanIfPrivateCfg: CanIfPrivateSoftwareFilterType=LINEAR
    CanIfPublicCfg: CanIfPublicPnSupport=false
  module config CanNm
    CanNmGlobalConfig:
      CanNmBusSynchronizationEnabled = false
      CanNmPassiveModeEnabled = true
      CanNmPnEiraCalcEnabled = false
      CanNmRemoteSleepIndEnabled = false
      CanNmUserDataEnabled = true
      CAN1_CAN_493c06b3 (CanNmChannelConfig):
        CanNmMsgReducedTime = 0.05
        CanNmNodeId = 0
        CanNmRepeatMessageTime = 0.4
        CanNmTimeoutTime = 1
        CanNmUserDataLength = 6
        CanNmWaitBusSleepTime = 0.75
        CanNmComMNetworkHandleRef = ComMConfigSet/CN_CAN1_06c72675
        CAN1_CAN_493c06b3_Rx (CanNmRxPdu)
  module config CanSM
    CanSMConfiguration
      CHNL_51ff2425 (CanSMManagerNetwork): CanSMComMNetworkHandleRef=ComMConfigSet/CN_CAN1_06c72675
        CT_CAN1_94f462e5 (CanSMController): CanSMControllerId=CanIfCtrlDrvCfg_7d254554/CT_CAN1_a48a0788
  module config Com
    ComConfig
      BCM1_1_oCAN1_fc3f747f_Tx (ComIPdu):
        ComIPduDirection = SEND
        ComIPduType = NORMAL
        ComIPduGroupRef = BCM_oCAN1_Tx_74467a05
        ComIPduSignalRef = LightState_oBCM1_1_oCAN1_eb869610_Tx
        ComPduIdRef = EcucPduCollection/BCM1_1_oCAN1_fc3f747f_Tx
        ComTxIPdu: ComMinimumDelayTime=0, ComTxIPduUnusedAreasDefault=0
          ComTxModeFalse
            ComTxMode: ComTxModeMode=PERIODIC, ComTxModeTimeOffset=0, ComTxModeTimePeriod=0.1
          ComTxModeTrue
            ComTxMode: ComTxModeMode=PERIODIC, ComTxModeTimeOffset=0, ComTxModeTimePeriod=0.1
      LCU1_1_oCAN1_2177667d_Rx (ComIPdu):
        ComIPduDirection = RECEIVE
        ComIPduType = NORMAL
        ComIPduGroupRef = BCM_oCAN1_Rx_221cdd83
        ComIPduSignalRef = LightCmd_oLCU1_1_oCAN1_f232dac2_Rx
        ComPduIdRef = EcucPduCollection/LCU1_1_oCAN1_2177667d_Rx
      BCM_oCAN1_Rx_221cdd83 (ComIPduGroup)
      BCM_oCAN1_Tx_74467a05 (ComIPduGroup)
      LightCmd_oLCU1_1_oCAN1_f232dac2_Rx (ComSignal):
        ComBitPosition = 7
        ComBitSize = 8
        ComSignalEndianness = BIG_ENDIAN
        ComSignalInitValue = 0
        ComSignalType = UINT8
        ComTimeout = 0
        ComSystemTemplateSystemSignalRef = LightCmd
      LightState_oBCM1_1_oCAN1_eb869610_Tx (ComSignal):
        ComBitPosition = 7
        ComBitSize = 8
        ComSignalEndianness = BIG_ENDIAN
        ComSignalInitValue = 0
        ComSignalType = UINT8
        ComTransferProperty = PENDING
        ComSystemTemplateSystemSignalRef = LightState
    ComGeneral
  module config ComM
    ComMConfigSet: ComMPncEnabled=false
      CN_CAN1_06c72675 (ComMChannel): ComMBusType=COMM_BUS_TYPE_CAN, ComMChannelId=0
        ComMNetworkManagement: ComMNmVariant=PASSIVE
        CN_CAN1_a66ced04 (ComMUserPerChannel): ComMUserChannel=CN_CAN1_d32cea4f
      CN_CAN1_d32cea4f (ComMUser): ComMUserIdentifier=0
    ComMGeneral: ComMPncIdCounting=COMM_PNC_ID_COUNT_FROM_NM_MESSAGE, ComMPncSupport=false
  module config Dio
    CommonPublishedInformation:  # Project Standard Configuration
      ArReleaseMajorVersion = 4
      ArReleaseMinorVersion = 2
      ArReleaseRevisionVersion = 2
      ModuleId = 120
      SwMajorVersion = 1
      SwMinorVersion = 0
      SwPatchVersion = 1
      VendorId = 43
    DioConfig  # Project Standard Configuration
      DioPort_PTE (DioPort): DioPortId=4  # Project Standard Configuration
        DioChannel_PTE20 (DioChannel): DioChannelId=20  # Project Standard Configuration
        DioChannel_PTE21 (DioChannel): DioChannelId=21  # Project Standard Configuration
    DioGeneral:  # Project Standard Configuration
      DioDevErrorDetect = false
      DioEnableUserModeSupport = false
      DioFlipChannelApi = true
      DioMaskedWritePortApi = false
      DioReadZeroForUndefinedPortPins = true
      DioReversePortBits = true
      DioVersionInfoApi = false
  module config EcuC
    EcucPduCollection: PduIdTypeEnum=UINT8, PduLengthTypeEnum=UINT8
      4 x Pdu, all with PduLength=8:
        BCM1_1_oCAN1_e0b79f82_Tx: SysTPduToFrameMappingRef=BCM1_1
        BCM1_1_oCAN1_fc3f747f_Tx
        LCU1_1_oCAN1_2177667d_Rx
        LCU1_1_oCAN1_27262c0c_Rx: SysTPduToFrameMappingRef=LCU1_1
  module config EcuM
    EcuMConfiguration
      EcuMCommonConfiguration
        EcuMDriverInitListOne
        EcuMDriverRestartList
        CN_CAN1_06c72675 (EcuMWakeupSource): EcuMWakeupSourceId=5, EcuMComMChannelRef=ComMConfigSet/CN_CAN1_06c72675
      EcuMFlexConfiguration: EcuMFlexModuleConfigurationRef=CanConfigSet
  module config Mcu
    CommonPublishedInformation:  # Project Standard Configuration
      ArReleaseMajorVersion = 4
      ArReleaseMinorVersion = 2
      ArReleaseRevisionVersion = 2
      ModuleId = 101
      SwMajorVersion = 1
      SwMinorVersion = 0
      SwPatchVersion = 1
      VendorApiInfix = 
      VendorId = 43
    McuDebugConfiguration: McuDisableCmuApi=false, McuDisableDemReportErrorStatus=false, McuEnablePeripheralCMU=false, McuGetMidrStructureApi=false, McuGetPeriphStateApi=false  # Project Standard Configuration
    McuGeneralConfiguration:  # Project Standard Configuration
      McuCalloutBeforePerformReset = false
      McuDevErrorDetect = false
      McuEnableUserModeSupport = false
      McuEnterLowPowerMode = false
      McuGetRamStateApi = false
      McuInitClock = true
      McuNoPll = false
      McuPerformResetApi = true
      McuPerformResetCallout = NULL_PTR
      McuTimeout = 50000
      McuVersionInfoApi = false
    McuModuleConfiguration:  # Project Standard Configuration
      McuClockSrcFailureNotification = ENABLED
      McuLPO1KClockEnable = true
      McuLPO32KClockEnable = true
      McuLPOClockSelect = LPO_CLK_128K
      McuNumberOfMcuModes = 1
      McuRTCCLKINFrequencyHz = 32000
      McuRamSectors = 0
      McuRtcClkSelect = SOSCDIV1_CLK
      McuAllowedModes: McuAllowHighSpeedRunMode=false, McuAllowVeryLowPowerModes=false  # Project Standard Configuration
      McuClockSettingConfig_0 (McuClockSettingConfig): McuClockSettingId=0, McuScgClkOutSelect=SCG_SLOW_CLK, McuSysClockUnderMcuControl=true  # Project Standard Configuration
        McuClkMonitor_0:  # Project Standard Configuration
          McuClkMonitorEn = false
          McuFrequencyHigherInterrupt = false
          McuFrequencyLowerInterrupt = false
          McuHighFrequencyRef = 16777215
          McuLowFrequencyRef = 0
          McuReferenceCountConfiguration = 65535
        McuClkMonitor_1:  # Project Standard Configuration
          McuClkMonitorEn = false
          McuFrequencyHigherInterrupt = false
          McuFrequencyLowerInterrupt = false
          McuHighFrequencyRef = 16777215
          McuLowFrequencyRef = 0
          McuReferenceCountConfiguration = 65535
        McuClockReferencePoint_0 (McuClockReferencePoint): McuClockFrequencySelect=RUN_SYS_CLK, McuClockReferencePointFrequency=80000000  # Project Standard Configuration
        McuFIRCClockConfig:  # Project Standard Configuration
          McuFIRCDiv1 = 1
          McuFIRCDiv1Frequency = 48000000
          McuFIRCDiv2 = 2
          McuFIRCDiv2Frequency = 24000000
          McuFIRCEnable = true
          McuFIRCFrequency = 48000000
          McuFIRCRangeSelect = TRIMMED_TO_48MHZ
          McuFIRCRegulatorEnable = false
          McuFIRCUnderMcuControl = true
        McuHsrunClockConfig:  # Project Standard Configuration
          McuBusClockDivider = 1
          McuBusClockFrequency = 48000000
          McuCoreClockDivider = 1
          McuCoreClockFrequency = 48000000
          McuFlashClockFrequency = 24000000
          McuPreDivSystemClockFrequency = 48000000
          McuScgClkOutFrequency = 24000000
          McuSlowClockDivider = 2
          McuSystemClockFrequency = 48000000
          McuSystemClockSwitch = FIRC
        41 x McuPeripheralClockConfig, all with McuPeripheralClockDivider=1, McuPeripheralClockEnable=true, McuPeripheralClockFrequency=0, McuPeripheralClockSelect=EXT_CLK_OR_CLK_OFF, McuPeripheralFractionalDivider=0:
          McuPeripheralClockConfig_0: McuPerName=FTFC  # Project Standard Configuration
          McuPeripheralClockConfig_1: McuPerName=DMAMUX0  # Project Standard Configuration
          McuPeripheralClockConfig_10: McuPerName=PDB1  # Project Standard Configuration
          McuPeripheralClockConfig_11: McuPerName=CRC  # Project Standard Configuration
          McuPeripheralClockConfig_12: McuPerName=PDB0  # Project Standard Configuration
          McuPeripheralClockConfig_13: McuPerName=LPIT  # Project Standard Configuration
          McuPeripheralClockConfig_14: McuPerName=FTM0  # Project Standard Configuration
          McuPeripheralClockConfig_15: McuPerName=FTM1  # Project Standard Configuration
          McuPeripheralClockConfig_16: McuPerName=FTM2  # Project Standard Configuration
          McuPeripheralClockConfig_17: McuPerName=ADC0  # Project Standard Configuration
          McuPeripheralClockConfig_18: McuPerName=RTC  # Project Standard Configuration
          McuPeripheralClockConfig_19: McuPerName=LPTMR0  # Project Standard Configuration
          McuPeripheralClockConfig_2: McuPerName=FLEXCAN0  # Project Standard Configuration
          McuPeripheralClockConfig_20: McuPerName=PORTA  # Project Standard Configuration
          McuPeripheralClockConfig_21: McuPerName=PORTB  # Project Standard Configuration
          McuPeripheralClockConfig_22: McuPerName=PORTC  # Project Standard Configuration
          McuPeripheralClockConfig_23: McuPerName=PORTD  # Project Standard Configuration
          McuPeripheralClockConfig_24: McuPerName=PORTE  # Project Standard Configuration
          McuPeripheralClockConfig_25: McuPerName=SAI0  # Project Standard Configuration
          McuPeripheralClockConfig_26: McuPerName=SAI1  # Project Standard Configuration
          McuPeripheralClockConfig_27: McuPerName=FLEXIO  # Project Standard Configuration
          McuPeripheralClockConfig_28: McuPerName=EWM  # Project Standard Configuration
          McuPeripheralClockConfig_29: McuPerName=LPI2C0  # Project Standard Configuration
          McuPeripheralClockConfig_3: McuPerName=FLEXCAN1  # Project Standard Configuration
          McuPeripheralClockConfig_30: McuPerName=LPI2C1  # Project Standard Configuration
          McuPeripheralClockConfig_31: McuPerName=LPUART0  # Project Standard Configuration
          McuPeripheralClockConfig_32: McuPerName=LPUART1  # Project Standard Configuration
          McuPeripheralClockConfig_33: McuPerName=LPUART2  # Project Standard Configuration
          McuPeripheralClockConfig_34: McuPerName=FTM4  # Project Standard Configuration
          McuPeripheralClockConfig_35: McuPerName=FTM5  # Project Standard Configuration
          McuPeripheralClockConfig_36: McuPerName=FTM6  # Project Standard Configuration
          McuPeripheralClockConfig_37: McuPerName=FTM7  # Project Standard Configuration
          McuPeripheralClockConfig_38: McuPerName=CMP0  # Project Standard Configuration
          McuPeripheralClockConfig_39: McuPerName=QSPI  # Project Standard Configuration
          McuPeripheralClockConfig_4: McuPerName=FTM3  # Project Standard Configuration
          McuPeripheralClockConfig_40: McuPerName=ENET  # Project Standard Configuration
          McuPeripheralClockConfig_5: McuPerName=ADC1  # Project Standard Configuration
          McuPeripheralClockConfig_6: McuPerName=FLEXCAN2  # Project Standard Configuration
          McuPeripheralClockConfig_7: McuPerName=LPSPI0  # Project Standard Configuration
          McuPeripheralClockConfig_8: McuPerName=LPSPI1  # Project Standard Configuration
          McuPeripheralClockConfig_9: McuPerName=LPSPI2  # Project Standard Configuration
        McuRunClockConfig:  # Project Standard Configuration
          McuBusClockDivider = 2
          McuBusClockFrequency = 40000000
          McuCoreClockDivider = 2
          McuCoreClockFrequency = 80000000
          McuFlashClockFrequency = 20000000
          McuPreDivSystemClockFrequency = 160000000
          McuScgClkOutFrequency = 20000000
          McuSlowClockDivider = 4
          McuSystemClockFrequency = 80000000
          McuSystemClockSwitch = SPLL
        McuSIMClockConfig:  # Project Standard Configuration
          McuClockOutDivider = 1
          McuClockOutEnable = false
          McuClockOutSelect = SCG_CLKOUT
          McuDMAClockGatingEnable = true
          McuDebugTraceDividerEnable = true
          McuEIMClockGatingEnable = true
          McuERMClockGatingEnable = true
          McuGPIOClockGatingEnable = false
          McuMPUClockGatingEnable = true
          McuMSCMClockGatingEnable = true
          McuTraceClockDivider = 1
          McuTraceClockFraction = 0
          McuTraceClockSelect = CORE_CLK
        McuSIRCClockConfig:  # Project Standard Configuration
          McuSIRCDiv1 = 1
          McuSIRCDiv1Frequency = 8000000
          McuSIRCDiv2 = 2
          McuSIRCDiv2Frequency = 4000000
          McuSIRCEnable = true
          McuSIRCFrequency = 8000000
          McuSIRCLowPowerEnable = false
          McuSIRCRangeSelect = HIGH_RANGE_CLOCK
          McuSIRCStopEnable = false
          McuSIRCUnderMcuControl = true
        McuSystemOSCClockConfig:  # Project Standard Configuration
          McuSOSCClockMonitorEnable = false
          McuSOSCClockMonitorResetEnable = false
          McuSOSCDiv1 = 1
          McuSOSCDiv1Frequency = 8000000
          McuSOSCDiv2 = 2
          McuSOSCDiv2Frequency = 4000000
          McuSOSCEnable = true
          McuSOSCExternalReferenceSelect = false
          McuSOSCFrequency = 8000000
          McuSOSCHighGainOscillatorSelect = false
          McuSOSCRangeSelect = HIGH_FREQ_RANGE
          McuSOSCUnderMcuControl = true
        McuSystemPll:  # Project Standard Configuration
          McuSPLLClockMonitorEnable = false
          McuSPLLClockMonitorResetEnable = false
          McuSPLLDiv1 = 4
          McuSPLLDiv1Frequency = 40000000
          McuSPLLDiv2 = 4
          McuSPLLDiv2Frequency = 40000000
          McuSPLLEnable = true
          McuSPLLFrequency = 160000000
          McuSPLLInputClkPreDivider = 1
          McuSPLLInputFrequency = 8000000
          McuSPLLMultiplier = 40
          McuSystemPllUnderMcuControl = true
        McuVlprClockConfig:  # Project Standard Configuration
          McuBusClockDivider = 1
          McuBusClockFrequency = 4000000
          McuCoreClockDivider = 2
          McuCoreClockFrequency = 4000000
          McuFlashClockFrequency = 1000000
          McuPreDivSystemClockFrequency = 8000000
          McuScgClkOutFrequency = 1000000
          McuSlowClockDivider = 4
          McuSystemClockFrequency = 4000000
          McuSystemClockSwitch = SIRC
      McuInterruptEvents: McuAlternateResetEvent=false, McuVoltageErrorEvent=false  # Project Standard Configuration
      McuModeSettingConf_0 (McuModeSettingConf): McuMode=0, McuPowerMode=RUN  # Project Standard Configuration
      McuPowerControl:  # Project Standard Configuration
        McuClockBiasDisable = false
        McuLPODisable = false
        McuLowPowerBiasEnable = false
        McuLowVoltageDetectInterruptEnable = false
        McuLowVoltageDetectResetEnable = false
        McuLowVoltageWarningInterruptEnable = false
        McuLpoTrimming = 0
      McuResetConfig: McuResetPinFilterBusClockSelect=0, McuResetPinFilterInRunAndWait=ALL_FILTERING_DISABLE, McuResetPinFilterInStopMode=ALL_FILTERING_DISABLE  # Project Standard Configuration
        McuSystemInterruptEnable:  # Project Standard Configuration
          McuCMULossOfClockResetInterrupt = false
          McuCoreLockupInterrupt = false
          McuExternalResetPinInterrupt = false
          McuGlobalInterrupt = false
          McuJTAGResetInterrupt = false
          McuLossOfClockInterrupt = false
          McuLossOfLockInterrupt = false
          McuMDMAPSystemResetInterrupt = false
          McuResetDelayTime = DELAY_10_LPO_CYCLES
          McuSoftwareInterrupt = false
          McuStopAcknowledgeErrorInterrupt = false
          McuWatchdogInterrupt = false
      McuSIMConfig  # Project Standard Configuration
        McuAdcOptionsConfiguration:  # Project Standard Configuration
          McuADC0PreTrigeerSourceSelect = PDB_PRE_TRIGGER
          McuADC0SoftwarePreTrigeerSourceSelect = SW_PRE_TRIGGER_DISABLE
          McuADC0TrigeerSourceSelect = PDB
          McuADC1PreTrigeerSourceSelect = PDB_PRE_TRIGGER
          McuADC1SoftwarePreTrigeerSourceSelect = SW_PRE_TRIGGER_DISABLE
          McuADC1TrigeerSourceSelect = PDB
          McuSoftwareTriggerToTRGMUX = false
        McuChipControlConfiguration:  # Project Standard Configuration
          McuAdcSupply = VDD
          McuEnableAdcSupplyMonitoring = false
          McuPDBBackToBackSelect = false
          McuPTB0InterleaveChannelSelect = false
          McuPTB13InterleaveChannelSelect = false
          McuPTB14InterleaveChannelSelect = false
          McuPTB1InterleaveChannelSelect = false
        McuFlexTimerConfiguration:  # Project Standard Configuration
          McuFTM0Ch{0..7}ModulationSelect = false
          McuFTM0ExternalClockPinSelect = TCLK0_PIN
          McuFTM0Fault{0..2}Select = FTM0_FLT{0..2}_PIN
          McuFTM0OBEControl = false
          McuFTM0SyncBit = false
          McuFTM1Ch0InputSelect = FTM1_CH0_INPUT
          McuFTM1ExternalClockPinSelect = TCLK0_PIN
          McuFTM1Fault{0..2}Select = FTM1_FLT{0..2}_PIN
          McuFTM1OBEControl = false
          McuFTM1SyncBit = false
          McuFTM2Ch0InputSelect = FTM2_CH0_INPUT
          McuFTM2Ch1InputSelect = FTM2_CHI1_INPUT
          McuFTM2ExternalClockPinSelect = TCLK0_PIN
          McuFTM2Fault{0..2}Select = FTM2_FLT{0..2}_PIN
          McuFTM2OBEControl = false
          McuFTM2SyncBit = false
          McuFTM3Ch{0..7}ModulationSelect = false
          McuFTM3ExternalClockPinSelect = TCLK0_PIN
          McuFTM3Fault{0..2}Select = FTM3_FLT{0..2}_PIN
          McuFTM3OBEControl = false
          McuFTM3SyncBit = false
          McuFTM4ExternalClockPinSelect = TCLK0_PIN
          McuFTM4OBEControl = false
          McuFTM4SyncBit = false
          McuFTM5ExternalClockPinSelect = TCLK0_PIN
          McuFTM5OBEControl = false
          McuFTM5SyncBit = false
          McuFTM6ExternalClockPinSelect = TCLK0_PIN
          McuFTM6OBEControl = false
          McuFTM6SyncBit = false
          McuFTM7ExternalClockPinSelect = TCLK0_PIN
          McuFTM7OBEControl = false
          McuFTM7SyncBit = false
          McuFTMGlobalLoadEnable = false
          McuFTM_GTBControl = false
          McuQspiClkSelect = false
          McuRMII_ClkSelect = false
          McuRMII_Clk_OBE = false
    McuPublishedInformation  # Project Standard Configuration
      15 x McuResetReasonConf:
        MCU_CMU_LOC_RESET: McuResetReason=14  # Project Standard Configuration
        MCU_CORE_LOCKUP_RESET: McuResetReason=3  # Project Standard Configuration
        MCU_EXTERNAL_PIN_RESET: McuResetReason=6  # Project Standard Configuration
        MCU_JTAG_RESET: McuResetReason=4  # Project Standard Configuration
        MCU_LOSS_OF_CLOCK_RESET: McuResetReason=9  # Project Standard Configuration
        MCU_LOSS_OF_LOCK_RESET: McuResetReason=8  # Project Standard Configuration
        MCU_LOW_OR_HIGH_VOLTAGE_DETECT_RESET: McuResetReason=10  # Project Standard Configuration
        MCU_MDM_AP_SYSTEM_RESET: McuResetReason=1  # Project Standard Configuration
        MCU_MULTIPLE_RESET_REASON: McuResetReason=12  # Project Standard Configuration
        MCU_NO_RESET_REASON: McuResetReason=11  # Project Standard Configuration
        MCU_POWER_ON_RESET: McuResetReason=5  # Project Standard Configuration
        MCU_RESET_UNDEFINED: McuResetReason=13  # Project Standard Configuration
        MCU_STOP_ACKNOWLEDGE_ERROR_RESET: McuResetReason=0  # Project Standard Configuration
        MCU_SW_RESET: McuResetReason=2  # Project Standard Configuration
        MCU_WATCHDOG_RESET: McuResetReason=7  # Project Standard Configuration
  module config Nm
    CN_CAN1_06c72675 (NmChannelConfig): NmPassiveModeEnabled=true, NmComMChannelRef=ComMConfigSet/CN_CAN1_06c72675
      CAN1_CAN_493c06b3 (NmBusType)
        NmStandardBusNmConfig: NmStandardBusType=NM_BUSNM_CANNM  # CAN1_CAN
    NmGlobalConfig
      NmGlobalFeatures: NmBusSynchronizationEnabled=false, NmNodeIdEnabled=true, NmUserDataEnabled=true
      NmGlobalProperties
  module config PduR
    PduRGeneral
    PduRRoutingTables
      PduRRoutingTable
        BCM1_1_oCAN1_fc3f747f_Tx (PduRRoutingPath)
          BCM1_1_oCAN1_e0b79f82_Tx (PduRDestPdu): PduRDestPduRef=EcucPduCollection/BCM1_1_oCAN1_e0b79f82_Tx
          PduRSrcPdu_6cbda9f1 (PduRSrcPdu): PduRSrcPduRef=EcucPduCollection/BCM1_1_oCAN1_fc3f747f_Tx
        LCU1_1_oCAN1_27262c0c_Rx (PduRRoutingPath)
          LCU1_1_oCAN1_27262c0c_Rx_b4eb5803_Rx (PduRDestPdu): PduRDestPduRef=EcucPduCollection/LCU1_1_oCAN1_2177667d_Rx
          PduRSrcPdu_b4eb5803 (PduRSrcPdu): PduRSrcPduRef=EcucPduCollection/LCU1_1_oCAN1_27262c0c_Rx
  module config Port
    CommonPublishedInformation:  # Project Standard Configuration
      ArReleaseMajorVersion = 4
      ArReleaseMinorVersion = 2
      ArReleaseRevisionVersion = 2
      ModuleId = 124
      SwMajorVersion = 1
      SwMinorVersion = 0
      SwPatchVersion = 1
      VendorId = 43
    PortConfigSet  # Project Standard Configuration
      NotUsedPortPin: PortPinDSE=Low_Drive_Strength, PortPinDirection=PORT_PIN_IN, PortPinLevelValue=PORT_PIN_LEVEL_LOW, PortPinPE=PullEnabled, PortPinPS=PullDown  # Project Standard Configuration
      PortContainer_JTAG (PortContainer): PortNumberOfPortPins=5  # Project Standard Configuration
        5 x PortPin, all with PortPinDSE=Low_drive_strength, PortPinInitialMode=PORT_GPIO_MODE, PortPinLevelValue=PORT_PIN_LEVEL_LOW, PortPinModeChangeable=false, PortPinPFE=false:
          PortPin_PTA10_JTAG_TDO: PortPinDirection=PORT_PIN_OUT, PortPinDirectionChangeable=true, PortPinId=6, PortPinMode=JTAG_TDO, PortPinPE=PullDisabled, PortPinPS=PullDown, PortPinPcr=10  # Project Standard Configuration
          PortPin_PTA4_JTAG_TMS: PortPinDirection=PORT_PIN_IN, PortPinDirectionChangeable=false, PortPinId=3, PortPinMode=JTAG_TMS_SWD_DIO, PortPinPE=PullEnabled, PortPinPS=PullUp, PortPinPcr=4  # Project Standard Configuration
          PortPin_PTA5_NRESET: PortPinDirection=PORT_PIN_IN, PortPinDirectionChangeable=true, PortPinId=7, PortPinMode=RESET_b, PortPinPE=PullEnabled, PortPinPS=PullUp, PortPinPcr=5  # Project Standard Configuration
          PortPin_PTC4_JTAG_TCLK: PortPinDirection=PORT_PIN_IN, PortPinDirectionChangeable=false, PortPinId=4, PortPinMode=JTAG_TCLK_SWD_CLK, PortPinPE=PullEnabled, PortPinPS=PullDown, PortPinPcr=68  # Project Standard Configuration
          PortPin_PTC5_JTAG_TDI: PortPinDirection=PORT_PIN_IN, PortPinDirectionChangeable=false, PortPinId=5, PortPinMode=JTAG_TDI, PortPinPE=PullEnabled, PortPinPS=PullUp, PortPinPcr=69  # Project Standard Configuration
      PortContainer_PTE (PortContainer): PortNumberOfPortPins=2  # Project Standard Configuration
        PortPin_PTE20 (PortPin):  # Project Standard Configuration
          PortPinDSE = Low_drive_strength
          PortPinDirection = PORT_PIN_OUT
          PortPinDirectionChangeable = false
          PortPinId = 1
          PortPinInitialMode = PORT_GPIO_MODE
          PortPinLevelValue = PORT_PIN_LEVEL_LOW
          PortPinMode = GPIO
          PortPinModeChangeable = false
          PortPinPE = PullEnabled
          PortPinPFE = false
          PortPinPS = PullDown
          PortPinPcr = 148
        PortPin_PTE21 (PortPin):  # Project Standard Configuration
          PortPinDSE = Low_drive_strength
          PortPinDirection = PORT_PIN_OUT
          PortPinDirectionChangeable = false
          PortPinId = 2
          PortPinInitialMode = PORT_GPIO_MODE
          PortPinLevelValue = PORT_PIN_LEVEL_LOW
          PortPinMode = GPIO
          PortPinModeChangeable = false
          PortPinPE = PullEnabled
          PortPinPFE = false
          PortPinPS = PullDown
          PortPinPcr = 149
    PortGeneral:  # Project Standard Configuration
      PortDevErrorDetect = false
      PortEnableUserModeSupport = false
      PortSet2PinsDirectionApi = false
      PortSetPinDirectionApi = false
      PortSetPinModeApi = false
      PortSetPinModeDoesNotTouchGpioLevel = false
      PortVersionInfoApi = true
  module config Resource
    CommonPublishedInformation:  # Project Standard Configuration
      ArReleaseMajorVersion = 4
      ArReleaseMinorVersion = 2
      ArReleaseRevisionVersion = 2
      ModuleId = 0
      SwMajorVersion = 1
      SwMinorVersion = 0
      SwPatchVersion = 1
      VendorId = 43
    ResourceGeneral: ResourceSubderivative=s32k148_lqfp144  # Project Standard Configuration
