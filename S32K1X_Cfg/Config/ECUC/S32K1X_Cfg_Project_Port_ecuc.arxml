AUTOSAR XML (schema 00045)
package /ActiveEcuC
  module config Port: implementation-config-variant=VARIANT-POST-BUILD-LOADABLE, module-description=Port_Impl
    PortConfigSet
      PortContainer_PTE (PortContainer): PortNumberOfPortPins=2
        PortPin_PTE20 (PortPin):
          PortPinDSE = Low_drive_strength
          PortPinDirection = PORT_PIN_OUT
          PortPinDirectionChangeable = false
          PortPinId = 1
          PortPinInitialMode = PORT_GPIO_MODE
          PortPinLevelValue = PORT_PIN_LEVEL_LOW
          PortPinMode = GPIO
          PortPinModeChangeable = false
          PortPinPE = PullEnabled
          PortPinPFE = false
          PortPinPS = PullDown
          PortPinPcr = 148
        PortPin_PTE21 (PortPin):
          PortPinDSE = Low_drive_strength
          PortPinDirection = PORT_PIN_OUT
          PortPinDirectionChangeable = false
          PortPinId = 2
          PortPinInitialMode = PORT_GPIO_MODE
          PortPinLevelValue = PORT_PIN_LEVEL_LOW
          PortPinMode = GPIO
          PortPinModeChangeable = false
          PortPinPE = PullEnabled
          PortPinPFE = false
          PortPinPS = PullDown
          PortPinPcr = 149
      PortContainer_JTAG (PortContainer): PortNumberOfPortPins=5
        5 x PortPin, all with PortPinDSE=Low_drive_strength, PortPinInitialMode=PORT_GPIO_MODE, PortPinLevelValue=PORT_PIN_LEVEL_LOW, PortPinModeChangeable=false, PortPinPFE=false:
          PortPin_PTA5_NRESET: PortPinDirection=PORT_PIN_IN, PortPinDirectionChangeable=true, PortPinId=7, PortPinMode=RESET_b, PortPinPE=PullEnabled, PortPinPS=PullUp, PortPinPcr=5
          PortPin_PTC5_JTAG_TDI: PortPinDirection=PORT_PIN_IN, PortPinDirectionChangeable=false, PortPinId=5, PortPinMode=JTAG_TDI, PortPinPE=PullEnabled, PortPinPS=PullUp, PortPinPcr=69
          PortPin_PTA4_JTAG_TMS: PortPinDirection=PORT_PIN_IN, PortPinDirectionChangeable=false, PortPinId=3, PortPinMode=JTAG_TMS_SWD_DIO, PortPinPE=PullEnabled, PortPinPS=PullUp, PortPinPcr=4
          PortPin_PTA10_JTAG_TDO: PortPinDirection=PORT_PIN_OUT, PortPinDirectionChangeable=true, PortPinId=6, PortPinMode=JTAG_TDO, PortPinPE=PullDisabled, PortPinPS=PullDown, PortPinPcr=10
          PortPin_PTC4_JTAG_TCLK: PortPinDirection=PORT_PIN_IN, PortPinDirectionChangeable=false, PortPinId=4, PortPinMode=JTAG_TCLK_SWD_CLK, PortPinPE=PullEnabled, PortPinPS=PullDown, PortPinPcr=68
      NotUsedPortPin: PortPinDSE=Low_Drive_Strength, PortPinDirection=PORT_PIN_IN, PortPinLevelValue=PORT_PIN_LEVEL_LOW, PortPinPE=PullEnabled, PortPinPS=PullDown
    PortGeneral:
      PortDevErrorDetect = false
      PortEnableUserModeSupport = false
      PortSet2PinsDirectionApi = false
      PortSetPinDirectionApi = false
      PortSetPinModeApi = false
      PortSetPinModeDoesNotTouchGpioLevel = false
      PortVersionInfoApi = true
    CommonPublishedInformation:
      ArReleaseMajorVersion = 4
      ArReleaseMinorVersion = 2
      ArReleaseRevisionVersion = 2
      ModuleId = 124
      SwMajorVersion = 1
      SwMinorVersion = 0
      SwPatchVersion = 1
      VendorId = 43
