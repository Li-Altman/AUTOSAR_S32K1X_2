AUTOSAR XML (schema 4-2-1)
package /ActiveEcuC
  module config PduR: implementation-config-variant=VARIANT-PRE-COMPILE, module-description=PduR_Impl
    PduRGeneral:
      PduRDevErrorDetect = true
      PduRVersionInfoApi = false
      PduRMetaDataSupport = false
      PduRPduCallback = false
      PduRSwitching = false
      PduRSafeBswChecks = false
      PduREnableDeferredTransmission = false
      PduREnableDeferredReception = false
      PduRSupportMulticore = false
      PduRGeneration:
        PduROutOfBoundsWriteProtectionStrategy = NONE
        PduROutOfBoundsWriteSanitizer = false
        PduROutOfBoundsReadSanitizer = false
        PduRNumericalDataTypeMinimizationStrategy = WITH_CAST
        PduRReduceConstantData2Define = false
        PduRBoolDataInArrayOfStructStrategy = BITMASKING
        PduRDeduplicateIndirectedData = true
        PduRDataDeduplicationStrategy = WITH_CAST
        PduRReduceBoolDataByNegationThreshold = 2
        PduRReduceBoolDataByNumericalComparisonThreshold = 2
        PduRReduceBoolDataByNumericalRelationThreshold = 2
        PduRReduceBoolDataByNumericalOperandStrategy = WITH_ANY_VALUE
        PduRReduceNumericalDataByOffsetThreshold = 2
        PduRReduceNumericalDataByArraySubtractionThreshold = 2
        PduRReduceDataByStreaming = false
        PduRShortSymbols = false
        PduRInterfacesForDeactivatedData = false
        PduRReferringKeysInComments = false
    PduRRoutingTables: PduRConfigurationId=0
      PduRRoutingTable
        BCM1_1_oCAN1_fc3f747f_Tx (PduRRoutingPath): PduRRoutingPathCommunicationType=COMMUNICATION_INTERFACE, PduRLockRef=PduRLock_PduRExclusiveArea
          PduRSrcPdu_6cbda9f1 (PduRSrcPdu): PduRSourcePduHandleId=0, PduRSrcPduDirection=TRANSMIT, PduRSrcPduRef=BCM1_1_oCAN1_fc3f747f_Tx, PduRSrcPduPduRBswModulesRef=Com
          BCM1_1_oCAN1_e0b79f82_Tx (PduRDestPdu):
            PduRDestPduHandleId = 0
            PduRDestPduDirection = TRANSMIT
            PduRDestPduRoutingType = API_FORWARDING
            PduRDestPduDataProcessing = IMMEDIATE
            PduRPduLengthHandlingStrategy = UNUSED
            PduRDestPduDataProvision = PDUR_DIRECT
            PduRTransmissionConfirmation = true
            PduRDestPduRef = BCM1_1_oCAN1_e0b79f82_Tx
            PduRDestPduPduRBswModulesRef = CanIf
        LCU1_1_oCAN1_27262c0c_Rx (PduRRoutingPath): PduRRoutingPathCommunicationType=COMMUNICATION_INTERFACE, PduRLockRef=PduRLock_PduRExclusiveArea
          PduRSrcPdu_b4eb5803 (PduRSrcPdu): PduRSourcePduHandleId=0, PduRSrcPduDirection=RECEIVE, PduRSrcPduRef=LCU1_1_oCAN1_27262c0c_Rx, PduRSrcPduPduRBswModulesRef=CanIf
          LCU1_1_oCAN1_27262c0c_Rx_b4eb5803_Rx (PduRDestPdu):
            PduRDestPduHandleId = 0
            PduRDestPduDirection = RECEIVE
            PduRDestPduRoutingType = API_FORWARDING
            PduRDestPduDataProcessing = IMMEDIATE
            PduRPduLengthHandlingStrategy = UNUSED
            PduRTransmissionConfirmation = false
            PduRDestPduRef = LCU1_1_oCAN1_2177667d_Rx
            PduRDestPduPduRBswModulesRef = Com
      PduRLock_PduRExclusiveArea (PduRLock)
        PduRExclusiveArea: PduRExclusiveAreaId=0
    CanIf (PduRBswModules):
      PduRCancelReceive = false
      PduRCancelTransmit = false
      PduRChangeParameterRequestApi = false
      PduRCommunicationInterface = true
      PduRLowerModule = true
      PduRTransportProtocol = false
      PduRTriggertransmit = false
      PduRTxConfirmation = true
      PduRUpperModule = false
      PduRUseTag = false
      PduRBswModuleRef = CanIf
    Com (PduRBswModules):
      PduRCancelReceive = false
      PduRCancelTransmit = false
      PduRChangeParameterRequestApi = false
      PduRCommunicationInterface = true
      PduRLowerModule = false
      PduRTransportProtocol = false
      PduRTriggertransmit = false
      PduRTxConfirmation = true
      PduRUpperModule = true
      PduRUseTag = false
      PduRBswModuleRef = Com
