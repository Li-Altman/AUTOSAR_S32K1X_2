AUTOSAR XML (schema 4-0-3)
package /TS_T40D2M10I1R0/Mcu_ib_bswmd/BswModuleDescriptions
  bsw module description Mcu
    bsw internal behavior McuBehavior
      31 x exclusive area:
        MCU_EXCLUSIVE_AREA_{00..30}
